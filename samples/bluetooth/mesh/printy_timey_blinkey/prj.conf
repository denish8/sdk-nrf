## CMakeLists.txt
```
#
# Copyright (c) 2019 Nordic Semiconductor ASA
#
# SPDX-License-Identifier: LicenseRef-Nordic-5-Clause
#

# SPDX-License-Identifier: Apache-2.0

cmake_minimum_required(VERSION 3.20.0)

find_package(Zephyr REQUIRED HINTS $ENV{ZEPHYR_BASE})
project(NONE)

target_sources(app PRIVATE src/main.c)
```

## sample.yaml
```
sample:
  description: Basic test sample, the simplest Zephyr
    application
  name: basic test
```

## prj.conf
```kconfig
#
# Copyright (c) 2019 Nordic Semiconductor ASA
#
# SPDX-License-Identifier: LicenseRef-Nordic-5-Clause
#
```

## src/main.c
```c
#include <zephyr.h>
#include <sys/printk.h>

#include <dk_buttons_and_leds.h>

static struct k_work_delayable continuous_printing;

static void message_print(struct k_work *work)
{
	printk("Hello World! %s\n", CONFIG_BOARD);
        k_work_reschedule(&continuous_printing, K_MSEC(1000));
}


void main(void)
{
        k_work_init_delayable(&continuous_printing, message_print);
        k_work_submit(&continuous_printing);

        
}
```
